## config/west.yml
```yaml
manifest:
  remotes:
    - name: zmkfirmware
      url-base: https://github.com/zmkfirmware
    - name: urob
      url-base: https://github.com/urob

  projects:
    - name: zmk
      remote: zmkfirmware
      revision: main          # whatever you are actually using now
      import: app/west.yml
    - name: zmk-adaptive-key
      remote: urob
      revision: main          # keep this in sync with the ZMK revision above

  self:
    path: config
```
